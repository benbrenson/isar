## meta-isar/conf/bblayers.conf.sample
```bitbake
# LAYER_CONF_VERSION is increased each time build/conf/bblayers.conf
# changes incompatibly
LCONF_VERSION = "6"

BBPATH = "${TOPDIR}"
BSPDIR := "${@os.path.abspath(os.path.dirname(d.getVar('FILE', True)) + '/../..')}"

BBFILES ?= ""

BBLAYERS ?= " \
  ${BSPDIR}/sources/isar/meta \
  ${BSPDIR}/sources/isar/meta-isar \
  ${BSPDIR}/sources/meta-sunxi \
  ${BSPDIR}/sources/meta-swupdate \
  ${BSPDIR}/sources/meta-unittest \
  "
BBLAYERS_NON_REMOVABLE ?= " \
  ${BSPDIR}/sources/isar/meta \
  "
```

## meta-isar/conf/distro/debian-stretch.conf
```bitbake
# Debian stretch multistrap configuration
#
# This software is a part of ISAR.
# Copyright (C) 2017 Mixed Mode GmbH

DISTRO_SUITE ?= "stretch"
DISTRO_ARCH ?= "armhf"
DISTRO_COMPONENTS ?= "main contrib non-free"
DISTRO_APT_SOURCE ?= "http://deb.debian.org/debian"
DISTRO_APT_SOURCE_SEC ?= "http://security.debian.org/debian-security"
DISTRO_KEYRINGS ?= "debian-archive-keyring"
DISTRO_CACHE_SECTION ?= "isar-cache"
DISTRO_REMOTE_SECTIONS ?= "base updates security"
```

## meta-isar/conf/distro/raspbian-stable.conf
```bitbake
# Raspbian stable multistrap configuration
#
# This software is a part of ISAR.
# Copyright (C) 2015-2016 ilbers GmbH

DISTRO_SUITE ?= "stable"
DISTRO_ARCH ?= "armhf"
DISTRO_COMPONENTS ?= "main contrib non-free firmware"
DISTRO_APT_SOURCE ?= "http://archive.raspbian.org/raspbian"
DISTRO_APT_SOURCE_SEC ?= "${DISTRO_APT_SOURCE}"
DISTRO_KEYRINGS ?= "debian-archive-keyring"
DISTRO_CACHE_SECTION ?= "isar-cache"
DISTRO_REMOTE_SECTIONS ?= "base updates security"
```

## meta-isar/conf/local.conf.sample
```bitbake
#
# This file is your local configuration file and is where all local user settings
# are placed. The comments in this file give some guide to the options a new user
# to the system might want to change but pretty much any configuration option can
# be set in this file. More adventurous users can look at local.conf.extended
# which contains other examples of configuration which can be placed in this file
# but new users likely won't need any of them initially.
#
# Lines starting with the '#' character are commented out and in some cases the
# default values are provided as comments to show people example syntax. Enabling
# the option is a question of removing the # character and making any change to the
# variable as required.

#
# Machine Selection
#
# You need to select a specific machine to target the build with. There are a selection
# of emulated machines available which can boot and run in the QEMU emulator:
#
# This sets the default machine if no other machine is selected.
# This variable should be set to the machine which is getting build, since wic will
# use this machine for running bitbake commands.
MACHINE ??= "nanopi-neo"

#
# Multistrap Configuration Selection
#
# You need to select a specific multistrap configuration which will used for both:
# generation of buildchroot environment and target root filesystem.
#
# This sets the default multistrap configuration:
DISTRO ??= "debian-stretch"


#
# Image features selection.
# Select different standart customization for the image.
# develop: Add a bunch of development tools (gcc, gdb, strace...) to the image.
#          This will increase the rootfs size significantly.
# systemd: Use systemd as init system
# sysvinit: Use sysvinit as init system
# test: Add unittest framework for testing purposes
# update: Add linux-image update service
IMAGE_FEATURES += "systemd"

#
#
# Multiple Configuration Selection
#
# If you want to use multiple configuration files for the build, list them in the
# following option.
#
# This sets the default multiple configurations used:
BBMULTICONFIG = "qemuarm rpi nanopi nanopi-air"

#
# Where to place downloads
#
# During a first build the system will download many different source code tarballs
# from various upstream projects. This can take a while, particularly if your network
# connection is slow. These are all stored in DL_DIR. When wiping and rebuilding you
# can preserve this directory to speed up this part of subsequent builds. This directory
# is safe to share between multiple builds on the same machine too.
#
# The default is a downloads directory under TOPDIR which is the build directory.
#
DL_DIR = "${BSPDIR}/downloads"

#
# Where to place shared-state files
#
# BitBake has the capability to accelerate builds based on previously built output.
# This is done using "shared state" files which can be thought of as cache objects
# and this option determines where those files are placed.
#
# You can wipe out TMPDIR leaving this directory intact and the build would regenerate
# from these files if no changes were made to the configuration. If changes were made
# to the configuration, only shared state files where the state was still valid would
# be used (done using checksums).
#
# The default is a sstate-cache directory under TOPDIR.
#
#SSTATE_DIR ?= "${TOPDIR}/sstate-cache"

#
# Where to place the build output
#
# This option specifies where the bulk of the building work should be done and
# where BitBake should place its temporary files and output. Keep in mind that
# this includes the extraction and compilation of many applications and the toolchain
# which can use Gigabytes of hard disk space.
#
# The default is a tmp directory under TOPDIR.
#
#TMPDIR = "${TOPDIR}/tmp"

#
# Interactive shell configuration
#
# Under certain circumstances the system may need input from you and to do this it
# can launch an interactive shell. It needs to do this since the build is
# multithreaded and needs to be able to handle the case where more than one parallel
# process may require the user's attention. The default is iterate over the available
# terminal types to find one that works.
#
# Examples of the occasions this may happen are when resolving patches which cannot
# be applied, to use the devshell or the kernel menuconfig
#
# Supported values are auto, gnome, xfce, rxvt, screen, konsole (KDE 3.x only), none
# Note: currently, Konsole support only works for KDE 3.x due to the way
# newer Konsole versions behave
#OE_TERMINAL = "auto"
# By default disable interactive patch resolution (tasks will just fail instead):
PATCHRESOLVE = "noop"

#
# Disk Space Monitoring during the build
#
# Monitor the disk space during the build. If there is less that 1GB of space or less
# than 100K inodes in any key build location (TMPDIR, DL_DIR, SSTATE_DIR), gracefully
# shutdown the build. If there is less that 100MB or 1K inodes, perform a hard abort
# of the build. The reason for this is that running completely out of space can corrupt
# files and damages the build in ways which may not be easily recoverable.
# It's necesary to monitor /tmp, if there is no space left the build will fail
# with very exotic errors.
BB_DISKMON_DIRS = "\
    STOPTASKS,${TMPDIR},1G,100K \
    STOPTASKS,${DL_DIR},1G,100K \
    STOPTASKS,${SSTATE_DIR},1G,100K \
    STOPTASKS,/tmp,100M,100K \
    ABORT,${TMPDIR},100M,1K \
    ABORT,${DL_DIR},100M,1K \
    ABORT,${SSTATE_DIR},100M,1K \
    ABORT,/tmp,10M,1K"

#
# Shared-state files from other locations
#
# As mentioned above, shared state files are prebuilt cache data objects which can
# used to accelerate build time. This variable can be used to configure the system
# to search other mirror locations for these objects before it builds the data itself.
#
# This can be a filesystem directory, or a remote url such as http or ftp. These
# would contain the sstate-cache results from previous builds (possibly from other
# machines). This variable works like fetcher MIRRORS/PREMIRRORS and points to the
# cache locations to check for the shared objects.
# NOTE: if the mirror uses the same structure as SSTATE_DIR, you need to add PATH
# at the end as shown in the examples below. This will be substituted with the
# correct path within the directory structure.
#SSTATE_MIRRORS ?= "\
#file://.* http://someserver.tld/share/sstate/PATH;downloadfilename=PATH \n \
#file://.* file:///some/local/dir/sstate/PATH"

# CONF_VERSION is increased each time build/conf/ changes incompatibly and is used to
# track the version of this file when it was generated. This can safely be ignored if
# this doesn't mean anything to you.
CONF_VERSION = "1"

#
# The default list of extra packages to be installed.
#IMAGE_INSTALL = "hello"

#
# Add debian package installed into the image at multistrap stage.
#IMAGE_PREINSTALL += "vim"

#
# Default parallel jobs for bitbake:
BB_NUMBER_THREADS ?= "${@bb.utils.cpu_count()}"

#
# How many processes make should run in parallel
PARALLEL_MAKE ?= "${@bb.utils.cpu_count()}"


DEB_EMAIL="default@email.com"
DEB_FULLNAME="Default Name"
DEB_HOST_ARCH="amd64"


# This is required in case of running the swupdate software on the target.
# If not, you can use it for your own purposes.
IMAGE_REVISION = "0.1"

# This required in case of running the update_service script, which in turn
# wrapps the swupdate software.
BROKER_IP ?= "192.168.8.1"
BROKER_PORT ?= "4242"
#Topic under which the update notification will be received.
UPDATE_TOPIC ?= "dev/0a24871b-6eb0-47a3-a66b-a3ebca77e376-598b4e4460e570ea/device"
```

## meta-isar/recipes-core/images/files/ext4.wks
```
# short-description: Create a single partition image file, not containing any partition table.
# long-description: Creates a single image which is not suitable for directly dd to media.

part --source rootfs --rootfs-dir=rootfs --fstype=ext4 --label roota --no-table
```

## meta-isar/recipes-core/images/files/isar-image-base.wks
```
# Base rootfs image creation kickstart file, describing an sd-card image with two redundant
# partitions.

bootloader --source bootstream
part /boot --source bootimg-partition --ondisk mmcblk --fstype=vfat --label boot --active --align 2048
part / --source rootfs --rootfs-dir=rootfs --ondisk mmcblk --fstype=ext4 --label roota --align 2048
part /rescue --source rootfs --rootfs-dir=rootfs --ondisk mmcblk --fstype=ext4 --label rootb --align 2048
```

## meta-isar/recipes-core/images/files/sdcard-redundant.wks
```
# short-description: Create a sd-card image with two redundant partitions
# long-description: Creates a partitioned sd-card image that the user
# can directly dd to boot media.

bootloader --source bootstream
part /boot --source bootimg-partition --fstype=vfat --label boot --active --align 2048
part /       --source rootfs --rootfs-dir=rootfs --ondisk mmcblk --fstype=ext4 --label rootfs_a --align 2048 ##ROOTFS_SIZE_OPTION##
part /rescue --source rootfs --rootfs-dir=rootfs --ondisk mmcblk --fstype=ext4 --label rootfs_b --align 2048 ##ROOTFS_SIZE_OPTION##
part /update --source rootfs --rootfs-dir=##UPDATE_DIR## --ondisk mmcblk --fstype=ext4 --label update --align 2048 ##ROOTFS_SIZE_OPTION##
```
